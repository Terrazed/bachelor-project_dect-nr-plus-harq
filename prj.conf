## CMakeLists.txt
```
cmake_minimum_required(VERSION 3.20.0)
find_package(Zephyr REQUIRED HINTS $ENV{ZEPHYR_BASE})

project(bachelor-project_dect-nr-plus-harq)

target_sources(app PRIVATE src/main.c src/dect_mac_phy_handler.c src/dect_mac_phy_handler_cb.c src/dect_mac_phy_handler_queue.c src/dect_mac_harq.c src/dect_mac_node.c src/dect_mac_utils.c)
```

## Kconfig
```
menu "Zephyr Kernel"
source "Kconfig.zephyr"
endmenu

module = BACHELOR-PROJECT_DECT-NR-PLUS-HARQ
module-str = BACHELOR PROJECT ON DECT NR+ HARQ

menu "Settings"
config CARRIER
    int "Carrier to use"
    default 0
    help
        The availability of the channels and the exact regulation to use them varies in different countries.
		See ETSI TS 103 636-2 5.4.2 for the calculation.

config NETWORK_ID
	int "Network ID"
	range 1 4294967295
	default 91

config TX_POWER
	int "TX power"
	range 0 13
	default 13
	help
	   	Transmission power, see table 6.2.1-3 of ETSI TS 103 636-4.

config TX_POWER_MARGIN_DBM
	int "TX power margin in dBm"
	range -128 127
	default 3
	help
		Transmission power margin in dBm. This value is added to the transmission power in dBm while computing the power requiered for communication. 

config RSSI_TARGET
	int "RSSI target"
	range -128 0
	default -80
	help
	   	Target RSSI value for the connection.
	   	By reducing this value, the transmission power will reduce at the price of a reduced range and a poorer signal quality.

config HARQ_RX_EXPIRY_TIME_US
	int "HARQ RX expiry time in microseconds"
	range 0 5000000
	default 1000000
	help
		A HARQ process soft buffer allocation is released when there have been no receptions to that buffer within the buffer's expiry time.

config HARQ_MAX_TRANSMISSIONS
	int "HARQ max transmissions"
	range 1 255
	default 5
	help
		Maximum number of transmissions for a HARQ transmission. If this number is reached, the HARQ transimsson is considered failed.
		(initial transmission + n retransmission) i.e. 5 means 1 initial transmission and 4 retransmissions.

config HARQ_RX_WAITING_TIME_MS
	int "HARQ RX waiting time in milliseconds"
	range 0 10000
	default 25
	help
		Waiting time in ms before consedering the transmission has not reached the target. After this time, a retransmission is triggered.

config HARQ_PROCESS_COUNT
	int "HARQ process count"
	range 1 8
	default 4
	help
		Number of HARQ processes to use. can be 1, 2, 4 or 8. the buffer memory is divided by this number. so the more processes, the less memory per process.

endmenu
```

## prj.conf
```kconfig
CONFIG_NRF_MODEM_LIB=y
CONFIG_MODEM_ANTENNA=n
CONFIG_NRF_MODEM_LINK_BINARY_DECT_PHY=y
CONFIG_HWINFO=y

CONFIG_LOG=y
CONFIG_LOG_MODE_IMMEDIATE=n
CONFIG_LOG_DEFAULT_LEVEL=3
CONFIG_GPIO=y
CONFIG_DK_LIBRARY=y

CONFIG_SYSTEM_WORKQUEUE_STACK_SIZE=1024

CONFIG_RSSI_TARGET=-90
CONFIG_CARRIER=1677
CONFIG_HARQ_RX_WAITING_TIME_MS=200
CONFIG_HARQ_MAX_TRANSMISSIONS=5
CONFIG_HARQ_PROCESS_COUNT=4

CONFIG_HEAP_MEM_POOL_SIZE=16384

CONFIG_SYS_HASH_FUNC32=y
CONFIG_SYS_HASH_MAP=y
```

## src/main.c
```c
#include <zephyr/kernel.h>

#include <nrf_modem_dect_phy.h>
#include <modem/nrf_modem_lib.h>

#include <dk_buttons_and_leds.h>

#include "dect_mac_phy_handler.h"
#include "dect_mac_phy_handler_types.h"
#include "dect_mac_harq.h"

#include <zephyr/logging/log.h>
LOG_MODULE_REGISTER(main, 4);


void button1_pressed(){
    dk_set_led(DK_LED1, 1);
    k_sleep(K_MSEC(200));
    dk_set_led(DK_LED1, 0);

    static uint8_t data[700];
    static uint16_t data_len;
    data_len = sprintf(data, "Hello Worldi 123456789016780167890123456789012345678901234567890123456789012345678901234567890678901234567890123456789012345678901234567890123456789012345678901234567890123dsafasdfsadfsadfasdfasdfasdfasdfasdfsadf45678906789012345678901234567890123456345678901234567890123456789012345678901234567890123456789012345678901test");

    struct dect_mac_harq_transmit_params params = {
        .data = data,
        .data_len = data_len,
        .start_time = 0,
        .receiver_id = 14231,
    };

    dect_mac_harq_transmit(params);

    struct dect_mac_phy_handler_rx_stop_params rx_stop_params = {
        .handle = 0x48000014,
    };

    dect_mac_phy_handler_rx_stop(rx_stop_params);
}

void button2_pressed(){
    dk_set_led(DK_LED2, 1);
    k_sleep(K_MSEC(200));
    dk_set_led(DK_LED2, 0);

    static uint8_t data[700];
    static uint16_t data_len;
    data_len = sprintf(data, "Hello Worldo");

    struct dect_mac_harq_transmit_params params = {
        .data = data,
        .data_len = data_len,
        .start_time = 0,
        .receiver_id = 29054,
    };

    dect_mac_harq_transmit(params);

    struct dect_mac_phy_handler_rx_stop_params rx_stop_params = {
        .handle = 0x48000014,
    };

    dect_mac_phy_handler_rx_stop(rx_stop_params);
}

void button3_pressed(){
    dk_set_led(DK_LED3, 1);
    k_sleep(K_MSEC(200));
    dk_set_led(DK_LED3, 0);
}

void button4_pressed(){
    dk_set_led(DK_LED4, 1);
    k_sleep(K_MSEC(200));
    dk_set_led(DK_LED4, 0);
}

void button_handler(uint32_t button_state, uint32_t has_changed)
{
    switch (has_changed)
    {
    case DK_BTN1_MSK:
        if (button_state & DK_BTN1_MSK)
        {
            LOG_INF("Button 1 pressed");
            button1_pressed();
        }
        break;
    case DK_BTN2_MSK:
        if (button_state & DK_BTN2_MSK)
        {
            LOG_INF("Button 2 pressed");
            button2_pressed();
        }
        break;
    case DK_BTN3_MSK:
        if (button_state & DK_BTN3_MSK)
        {
            LOG_INF("Button 3 pressed");
            button3_pressed();
        }
        break;
    case DK_BTN4_MSK:
        if (button_state & DK_BTN4_MSK)
        {
            LOG_INF("Button 4 pressed");
            button4_pressed();
        }
        break;
    }

}


int main(void)
{
    LOG_DBG("Starting main");

    int err;

    /* initialize the buttons */
    dk_buttons_init(button_handler);
    if(err)
    {
        LOG_ERR("Failed to initialize buttons");
        return err;
    }

    /* initialize the leds */
    dk_leds_init();
    if(err)
    {
        LOG_ERR("Failed to initialize leds");
        return err;
    }

    /* initialize the modem */
    
    err = dect_mac_phy_handler_start_modem();
    if (err)
    {
        LOG_ERR("Failed to start modem");
        return err;
    }

    LOG_DBG("Modem started");

    /* permanent receiving */
    struct dect_mac_phy_handler_rx_params rx_params = {
        .handle = 0x14,
        .rx_mode = NRF_MODEM_DECT_PHY_RX_MODE_SINGLE_SHOT,
        .rx_period_ms = 10000,
        .receiver_identity = 0,
        .start_time = 0,
    };
    dect_phy_queue_put(RX, (union dect_mac_phy_handler_params*)&rx_params, PRIORITY_PERMANENT);    

    return 0;
}
```

## src/dect_mac_error_code.h
```c
#ifndef DECT_MAC_ERROR_CODE_H
#define DECT_MAC_ERROR_CODE_H

enum dect_mac_error_code
{
    OK = 0,                      // No error
    UNKNOWN_ERR = 1,             // An unknown error occurred
    NO_FREE_HARQ = 2,            // the program does not have any free harq process at the moment
    NO_MEM_HEAP = 3,             // the program does not have enough memory in the heap to allocate the needed memory
    NO_FREE_NODE = 4,            // the program does not have any free node at the moment
    NODE_NOT_FOUND = 5,          // the node was not found in the hashmap
    POWER_NOT_IN_RANGE = 6,      // the power is not in the range of 0 to 15
    CHANNEL_TOO_NOISY = 7,       // the channel is too noisy to transmit with <10% PER
    MIN_MCS_REACHED = 8,         // the minimum MCS has already been reached and it cannot be decreased
    MAX_MCS_REACHED = 9,         // the maximum MCS has already been reached and it cannot be increased
    NO_MEM_SLAB = 10,            // the program does not have enough memory in the slab to allocate the needed memory
    FUNC_NOT_EXIST = 11,         // the function does not exist
    PACKET_TOO_BIG = 12,         // the packet is too big for the given MCS
    INVALID_PROCESS_NUMBER = 13, // the process number is invalid
    BUFFER_TOO_SMALL = 14,       // the buffer is too small
};

#endif // DECT_MAC_ERROR_CODE_H
```

## src/dect_mac_harq.c
```c
#include "dect_mac_harq.h"

#include <zephyr/logging/log.h>
LOG_MODULE_REGISTER(harq, 3);

K_THREAD_STACK_DEFINE(dect_mac_harq_work_queue_stack, DECT_MAC_HARQ_WORK_QUEUE_STACK_SIZE);

bool harq_process_occupied[CONFIG_HARQ_PROCESS_COUNT] = {0};
struct dect_mac_harq_process harq_processes[CONFIG_HARQ_PROCESS_COUNT] = {0};
bool dect_mac_harq_initialized = false;
struct k_work_q dect_mac_harq_work_queue;

int dect_mac_harq_request(struct phy_ctrl_field_common_type2 *header, uint64_t start_time)
{
    /* initialize if not already initialized */
    dect_mac_harq_init_process(&harq_processes[header->df_harq_process_nr], header->df_harq_process_nr); // initialize the process

    /* get packet length */
    uint8_t packet_length = header->packet_length;
    uint16_t packet_length_bytes = dect_mac_utils_get_bytes_from_packet_length(packet_length, header->df_mcs);

    /* remove buffer size */
    dect_mac_harq_remove_buffer_space(header->df_harq_process_nr, packet_length_bytes);

    /* set the feedback */
    struct feedback feedback;

    if (packet_length_bytes > capabilities.harq_soft_buf_size / 8 / CONFIG_HARQ_PROCESS_COUNT)
    {
        LOG_ERR("Packet length bigger than buffer size");
        feedback.format = FEEDBACK_FORMAT_6;
        feedback.info.format_6.harq_process_number = header->df_harq_process_nr;
        feedback.info.format_6.channel_quality_indicator = dect_mac_node_get_cqi(header->transmitter_id_hi << 8 | header->transmitter_id_lo);
        feedback.info.format_6.buffer_status = dect_mac_harq_get_buffer_status(header->df_harq_process_nr);
        feedback.info.format_6.reserved = 0;
    }
    else
    {
        feedback.format = FEEDBACK_FORMAT_1;
        feedback.info.format_1.channel_quality_indicator = dect_mac_node_get_cqi(header->transmitter_id_hi << 8 | header->transmitter_id_lo);
        feedback.info.format_1.transmission_feedback = NACK; // this will be changed to ACK by the phy layer if the PDC crc is correct
        feedback.info.format_1.harq_process_number = header->df_harq_process_nr;
        feedback.info.format_1.buffer_status = dect_mac_harq_get_buffer_status(header->df_harq_process_nr);
    }

    /* config the operation */
    struct dect_mac_phy_handler_tx_harq_params params = {
        .handle = (HANDLE_HARQ + header->df_harq_process_nr) | (1 << 27),
        .lbt_enable = false,
        .data = NULL,
        .data_size = 0,
        .receiver_id = header->transmitter_id_hi << 8 | header->transmitter_id_lo,
        .feedback = feedback,
        .start_time = start_time + ((3 + packet_length) * 10000 / 24 * NRF_MODEM_DECT_MODEM_TIME_TICK_RATE_KHZ / 1000),
    };

    /* send the acknoledgement */
    dect_mac_phy_handler_tx_harq(params);
    int ret = dect_phy_queue_put(PLACEHOLDER, NO_PARAMS, PRIORITY_CRITICAL);
    return ret;
}

void dect_mac_harq_response(struct phy_ctrl_field_common_type2 *header)
{
    /* get the feedback infos */
    union feedback_info feedback;
    enum nrf_mac_feedback_format format = header->feedback_format;
    feedback.byte.hi = header->feedback_info_hi;
    feedback.byte.lo = header->feedback_info_lo;

    /* get the harq process */
    struct dect_mac_harq_process *harq_process = &harq_processes[feedback.format_1.harq_process_number];

    if (format == FEEDBACK_FORMAT_1)
    {
        /* check if the transmission was successful */
        if (feedback.format_1.transmission_feedback == ACK)
        {
            LOG_INF("ACK received for harq process %d", feedback.format_1.harq_process_number);
            k_work_cancel_delayable(&harq_process->retransmission_work); // stop the scheduled work
            dect_mac_harq_give_process(harq_process);
        }
        else
        {
            LOG_WRN("NACK received for harq process %d", feedback.format_1.harq_process_number);
            dect_mac_harq_increment_redundancy_version(harq_process);
            k_work_reschedule_for_queue(&dect_mac_harq_work_queue, &harq_process->retransmission_work, K_NO_WAIT); // schedule the retransmission work
        }
    }
    else if (format == FEEDBACK_FORMAT_6)
    {
        LOG_WRN("NACK received for harq process %d and buffer not big enough", feedback.format_6.harq_process_number);
        harq_process->redundancy_version = 0;                                                                  // the other device can't store the data, so we reset the redundancy version to send the full data
        k_work_reschedule_for_queue(&dect_mac_harq_work_queue, &harq_process->retransmission_work, K_NO_WAIT); // schedule the retransmission work
    }
}

int dect_mac_harq_transmit(struct dect_mac_harq_transmit_params params)
{
    /* get a harq process */
    struct dect_mac_harq_process *harq_process = dect_mac_harq_take_process();
    if (harq_process == NULL)
    {
        return NO_FREE_HARQ;
    }

    /* copy the data to the harq process */
    uint8_t *data = k_malloc(params.data_len);
    if (data == NULL)
    {
        dect_mac_harq_give_process(harq_process);
        LOG_ERR("No memory for harq data");
        return NO_MEM_HEAP;
    }
    memcpy(data, params.data, params.data_len);

    /* initialize the harq process */
    harq_process->data = data;
    harq_process->data_len = params.data_len;
    harq_process->receiver_id = params.receiver_id;
    harq_process->transmission_count = 1; // first transmission

    struct dect_mac_phy_handler_tx_rx_params tx_rx_params = {
        .handle = HANDLE_HARQ + harq_process->process_number,
        .tx_usage = HARQ,
        .lbt_enable = false,
        .data = harq_process->data,
        .data_size = harq_process->data_len,
        .receiver_id = harq_process->receiver_id,
        .feedback = DECT_MAC_PHY_HANDLER_NO_FEEDBACK,
        .harq = {
            .redundancy_version = harq_process->redundancy_version,
            .new_data_indication = harq_process->new_data_indication,
            .harq_process_nr = harq_process->process_number,
        },
        .rx_mode = NRF_MODEM_DECT_PHY_RX_MODE_SINGLE_SHOT,
        .rx_period_ms = CONFIG_HARQ_RX_WAITING_TIME_MS,
        .start_time = params.start_time,
    };

    LOG_INF("Transmitting... (harq process: %d, count: %d, rv: %d)", harq_process->process_number, harq_process->transmission_count, harq_process->redundancy_version);
    return dect_phy_queue_put(TX_RX, (union dect_mac_phy_handler_params *)&tx_rx_params, PRIORITY_HIGH);
}

void dect_mac_harq_retransmission_work_handler(struct k_work *work)
{
    /* find the calling harq process */
    struct dect_mac_harq_process *harq_process = CONTAINER_OF((struct k_work_delayable *)work, struct dect_mac_harq_process, retransmission_work);

    /* check if the transmission count is less than the maximum */
    if (harq_process->transmission_count < CONFIG_HARQ_MAX_TRANSMISSIONS)
    {
        dect_mac_harq_retransmit(harq_process);
    }
    else
    {
        LOG_WRN("Max retransmissions reached for harq process %d", harq_process->process_number);
        dect_mac_harq_give_process(harq_process);
    }
}

int dect_mac_harq_retransmit(struct dect_mac_harq_process *harq_process)
{
    harq_process->transmission_count++; // incremenrt transmission

    dect_mac_node_add_power(harq_process->receiver_id, harq_process->transmission_count); // add power to the receiver
    dect_mac_node_reduce_mcs(harq_process->receiver_id, 1);                               // reduce the MCS of the receiver

    LOG_INF("Transmitting... (harq process: %d, count: %d, rv: %d)", harq_process->process_number, harq_process->transmission_count, harq_process->redundancy_version);

    /* config tx-rx operation */
    struct dect_mac_phy_handler_tx_rx_params tx_rx_params = {
        .handle = HANDLE_HARQ + harq_process->process_number,
        .tx_usage = HARQ,
        .lbt_enable = false,
        .data = harq_process->data,
        .data_size = harq_process->data_len,
        .receiver_id = harq_process->receiver_id,
        .feedback = DECT_MAC_PHY_HANDLER_NO_FEEDBACK,
        .harq = {
            .redundancy_version = harq_process->redundancy_version,
            .new_data_indication = harq_process->new_data_indication,
            .harq_process_nr = harq_process->process_number,
        },
        .rx_mode = NRF_MODEM_DECT_PHY_RX_MODE_SINGLE_SHOT,
        .rx_period_ms = CONFIG_HARQ_RX_WAITING_TIME_MS,
        .start_time = 0,
    };

    return dect_phy_queue_put(TX_RX, (union dect_mac_phy_handler_params *)&tx_rx_params, PRIORITY_MEDIUM);
}

void dect_mac_harq_increment_redundancy_version(struct dect_mac_harq_process *harq_process)
{
    /* increment the redundancy version */
    /* increment pattern: 0 -> 2 -> 3 -> 1 -> 0 -> ... */

    switch (harq_process->redundancy_version)
    {
    case 0:
        harq_process->redundancy_version = 2;
        break;
    case 1:
        harq_process->redundancy_version = 0;
        break;
    case 2:
        harq_process->redundancy_version = 3;
        break;
    case 3:
        harq_process->redundancy_version = 1;
        break;
    default:
        LOG_ERR("Invalid redundancy version");
        break;
    }
}

uint8_t dect_mac_harq_get_buffer_status(uint32_t process_number)
{
    if (process_number >= CONFIG_HARQ_PROCESS_COUNT)
    {
        LOG_ERR("Invalid process number");
        return 0;
    }
    else
    {
        uint8_t buffer_status;
        uint32_t process_buffer_size = harq_processes[process_number].buffer_size;

        if (process_buffer_size == 0)
        {
            buffer_status = 0;
        }
        else if (process_buffer_size <= 16)
        {
            buffer_status = 0x1;
        }
        else if (process_buffer_size <= 32)
        {
            buffer_status = 0x2;
        }
        else if (process_buffer_size <= 64)
        {
            buffer_status = 0x3;
        }
        else if (process_buffer_size <= 128)
        {
            buffer_status = 0x4;
        }
        else if (process_buffer_size <= 256)
        {
            buffer_status = 0x5;
        }
        else if (process_buffer_size <= 512)
        {
            buffer_status = 0x6;
        }
        else if (process_buffer_size <= 1024)
        {
            buffer_status = 0x7;
        }
        else if (process_buffer_size <= 2048)
        {
            buffer_status = 0x8;
        }
        else if (process_buffer_size <= 4096)
        {
            buffer_status = 0x9;
        }
        else if (process_buffer_size <= 8192)
        {
            buffer_status = 0xa;
        }
        else if (process_buffer_size <= 16384)
        {
            buffer_status = 0xb;
        }
        else if (process_buffer_size <= 32768)
        {
            buffer_status = 0xc;
        }
        else if (process_buffer_size <= 65536)
        {
            buffer_status = 0xd;
        }
        else if (process_buffer_size <= 131072)
        {
            buffer_status = 0xe;
        }
        else
        {
            buffer_status = 0xf;
        }

        return buffer_status;
    }
}

int dect_mac_harq_remove_buffer_space(uint32_t process_number, uint8_t byte_count)
{
    if (process_number >= CONFIG_HARQ_PROCESS_COUNT)
    {
        LOG_ERR("Invalid process number");
        return INVALID_PROCESS_NUMBER;
    }
    if (harq_processes[process_number].buffer_size < byte_count)
    {
        LOG_ERR("Not enough space in the buffer");
        return BUFFER_TOO_SMALL;
    }
    else
    {
        harq_processes[process_number].buffer_size -= byte_count;
        return OK;
    }
}

struct dect_mac_harq_process *dect_mac_harq_take_process()
{
    /* initialize if not already initialized */
    if (dect_mac_harq_initialized == false)
    {
        dect_mac_harq_initialize();
    }

    /* loop through all processes */
    for (int i = 0; i < CONFIG_HARQ_PROCESS_COUNT; i++)
    {
        if (!harq_process_occupied[i])
        {                                                                                   // find a free process
            harq_process_occupied[i] = true;                                                // set the process as occupied
            harq_processes[i].new_data_indication = !harq_processes[i].new_data_indication; // toggle the new data indication
            return &harq_processes[i];                                                      // return the process
        }
    }

    LOG_ERR("No free harq process found");
    return NULL;
}

void dect_mac_harq_give_process(struct dect_mac_harq_process *harq_process)
{
    /* initialize if not already initialized */
    if (dect_mac_harq_initialized == false)
    {
        dect_mac_harq_initialize();
    }

    LOG_DBG("Giving back harq process %d", harq_process->process_number);

    dect_mac_harq_init_process(harq_process, harq_process->process_number); // initialize the process
    harq_process_occupied[harq_process->process_number] = false;            // set the process as free
    k_work_cancel_delayable(&harq_process->retransmission_work);            // cancel the retransmission work
}

void dect_mac_harq_init_process(struct dect_mac_harq_process *harq_process, uint32_t process_number)
{
    LOG_DBG("Initializing harq process %d", process_number);

    harq_process->process_number = process_number;
    k_free(harq_process->data); // free the data (if any)
    harq_process->data = NULL;
    harq_process->data_len = 0;
    harq_process->receiver_id = 0;
    harq_process->transmission_count = 0;
    harq_process->redundancy_version = 0;
    harq_process->buffer_size = capabilities.harq_soft_buf_size / 8 / CONFIG_HARQ_PROCESS_COUNT;
}

void dect_mac_harq_initialize()
{
    /* initialize only once */
    if (dect_mac_harq_initialized == false)
    {

        k_work_queue_init(&dect_mac_harq_work_queue);
        k_work_queue_start(&dect_mac_harq_work_queue, dect_mac_harq_work_queue_stack, K_THREAD_STACK_SIZEOF(dect_mac_harq_work_queue_stack), 8, NULL);

        /* loop through all processes */
        for (int i = 0; i < CONFIG_HARQ_PROCESS_COUNT; i++)
        {
            dect_mac_harq_init_process(&harq_processes[i], i); // initialize the process
            harq_process_occupied[i] = false;                  // set the process as free
            harq_processes[i].new_data_indication = true;      // set the new data indication to true
            k_work_init_delayable(&harq_processes[i].retransmission_work, dect_mac_harq_retransmission_work_handler); // initialize the retransmission work
        }
        dect_mac_harq_initialized = true; // set the flag to true
        LOG_DBG("Harq initialized");
    }
}
```

## src/dect_mac_harq.h
```c
#ifndef DECT_MAC_HARQ_H
#define DECT_MAC_HARQ_H

#include <zephyr/kernel.h>

#include "dect_mac_phy_handler_types.h"
#include "dect_mac_phy_handler.h"
#include "dect_mac_node.h"

#include "dect_mac_error_code.h"

#define DECT_MAC_HARQ_WORK_QUEUE_STACK_SIZE 1024

#define HANDLE_HARQ 0xA0
#define ACK 1
#define NACK 0

/* struct that represent a harq process */
struct dect_mac_harq_process
{
    uint32_t process_number;
    void *data;
    size_t data_len;
    uint32_t receiver_id;
    uint8_t transmission_count;
    uint8_t redundancy_version;
    uint8_t new_data_indication;
    struct k_work_delayable retransmission_work;
    uint32_t buffer_size;
};

/* struct that contains all the needed parameters to transmit a harq message */
struct dect_mac_harq_transmit_params
{
    void *data;
    size_t data_len;
    uint64_t start_time;
    uint32_t receiver_id;
};

/* function to handle the harq request (sending an acknowledgement)*/
int dect_mac_harq_request(struct phy_ctrl_field_common_type2 *header, uint64_t start_time);

/* function to handle the harq response (receiving the acknowledgment)*/
void dect_mac_harq_response(struct phy_ctrl_field_common_type2 *header);

/* function to transmit a harq message */
int dect_mac_harq_transmit(struct dect_mac_harq_transmit_params params);

/* function that handle the retransmission work */
void dect_mac_harq_retransmission_work_handler(struct k_work *work);

/* function to handle the harq retransmission */
int dect_mac_harq_retransmit(struct dect_mac_harq_process *harq_process);

/* function to increment the redundancy version of a harq process */
void dect_mac_harq_increment_redundancy_version(struct dect_mac_harq_process *harq_process);

/* function that gets the buffer status from the harq process number */
uint8_t dect_mac_harq_get_buffer_status(uint32_t process_number);

/* function that removes space in the buffer */
int dect_mac_harq_remove_buffer_space(uint32_t process_number, uint8_t byte_count);

/* function to get an avaiable harq process */
struct dect_mac_harq_process *dect_mac_harq_take_process();

/* function to give back a harq process */
void dect_mac_harq_give_process(struct dect_mac_harq_process *harq_process);

/* function to init a harq process */
void dect_mac_harq_init_process(struct dect_mac_harq_process *harq_process, uint32_t process_number);

/* function to init all the file */
void dect_mac_harq_initialize();

/* class initialisation flag */
extern bool dect_mac_harq_initialized;

/* array of the free harq processes */
extern bool harq_process_occupied[CONFIG_HARQ_PROCESS_COUNT];

/* array of the harq processes */
extern struct dect_mac_harq_process harq_processes[CONFIG_HARQ_PROCESS_COUNT];

/* work queue that is used to schedule the execution of a retransmission */
extern struct k_work_q dect_mac_harq_work_queue;

#endif // DECT_MAC_HARQ_H
```

## src/dect_mac_node.c
```c
#include "dect_mac_node.h"

#include <zephyr/logging/log.h>
#include <zephyr/drivers/hwinfo.h>
LOG_MODULE_REGISTER(node, 3);

SYS_HASHMAP_DEFINE(node_hashmap); // create a hashmap for the nodes

K_MUTEX_DEFINE(node_mutex); // create a mutex for the nodes

K_THREAD_DEFINE(dect_mac_node_thread_id, 512, dect_mac_node_thread, NULL, NULL, NULL, 1, 0, 0); // create a thread for cleaning unused nodes

void dect_mac_node_thread()
{
    while (1)
    {
        k_sleep(DECT_MAC_NODE_DELETE_TIMEOUT);
        dect_mac_node_clean_unused_nodes();
    }
}

void dect_mac_node_clean_unused_nodes()
{

    struct sys_hashmap_iterator iterator;
    struct sys_hashmap_iterator delete_iterator;
    struct node *node_ptr;

    node_hashmap.api->iter(&node_hashmap, &iterator); // initialize iterator
    if (sys_hashmap_iterator_has_next(&iterator))
    {
        iterator.next(&iterator); // move to first node
    }
    while (sys_hashmap_iterator_has_next(&iterator))
    {

        memcpy(&delete_iterator, &iterator, sizeof(struct sys_hashmap_iterator)); // save last iterator

        iterator.next(&iterator); // move to next node (this has to be done before deleting the node to avoid iterator corruption)

        node_ptr = (struct node *)delete_iterator.value; // get node

        if (!node_ptr->used)
        {
            LOG_INF("deleting node %d", node_ptr->address);
            dect_mac_node_delete_node(node_ptr->address); // delete node
        }
        else
        {
            LOG_INF("node %d is used, unsetting the flag", node_ptr->address);
            node_ptr->used = false; // reset used flag to see if node is used until next iteration
        }
    }
    if (!sys_hashmap_is_empty(&node_hashmap))
    {                                             // deleting last node if needed
        node_ptr = (struct node *)iterator.value; // get node

        if (!node_ptr->used)
        {
            LOG_INF("deleting node %d", node_ptr->address);
            dect_mac_node_delete_node(node_ptr->address); // delete node
        }
        else
        {
            LOG_INF("node %d is used, unsetting the flag", node_ptr->address);
            node_ptr->used = false; // reset used flag to see if node is used until next iteration
        }
    }
}

uint8_t dect_mac_node_get_tx_power(uint32_t address)
{
    uint64_t node_addr;
    struct node *node_ptr;
    uint8_t result;

    bool should_create_node = false;

    k_mutex_lock(&node_mutex, K_FOREVER);
    {
        if (sys_hashmap_get(&node_hashmap, address, (uint64_t *)&node_addr))
        {
            node_ptr = (struct node *)node_addr;
            node_ptr->used = true; // mark node as used
            result = node_ptr->tx_power;
            LOG_DBG("tx_power: %d, key: %d", result, address);
        }
        else
        {
            LOG_INF("tx_power: node %d not found, creating the node", address);
            should_create_node = true;
        }
    }
    k_mutex_unlock(&node_mutex);

    if (should_create_node)
    {
        int ret = dect_mac_node_create_node(address, CONFIG_TX_POWER, capabilities.mcs_max);
        if (ret)
        {
            LOG_ERR("tx_power: cannot create node");
        }
        result = CONFIG_TX_POWER;
    }

    return result;
}

int8_t dect_mac_node_get_mcs(uint32_t address)
{
    uint64_t node_addr;
    struct node *node_ptr;
    int8_t result;

    bool should_create_node = false;

    k_mutex_lock(&node_mutex, K_FOREVER);
    {
        if (sys_hashmap_get(&node_hashmap, address, (uint64_t *)&node_addr))
        {
            node_ptr = (struct node *)node_addr;
            node_ptr->used = true; // mark node as used
            result = node_ptr->mcs;
            LOG_DBG("mcs: %d, key: %d", result, address);
        }
        else
        {
            LOG_INF("mcs: node %d not found, creating the node", address);
            should_create_node = true;
        }
    }
    k_mutex_unlock(&node_mutex);

    if (should_create_node)
    {
        int ret = dect_mac_node_create_node(address, CONFIG_TX_POWER, capabilities.mcs_max);
        if (ret)
        {
            LOG_ERR("mcs: cannot create node");
        }

        result = capabilities.mcs_max;
    }

    return result;
}

uint8_t dect_mac_node_get_cqi(uint32_t address)
{
    uint64_t node_addr;
    struct node *node_ptr;
    uint8_t result;

    bool should_create_node = false;

    k_mutex_lock(&node_mutex, K_FOREVER);
    {
        if (sys_hashmap_get(&node_hashmap, address, (uint64_t *)&node_addr))
        {
            node_ptr = (struct node *)node_addr;
            node_ptr->used = true; // mark node as used
            result = node_ptr->mcs + 1;
            LOG_DBG("cqi: %d, key: %d", result, address);
        }
        else
        {
            LOG_INF("cqi: node %d not found, creating the node", address);
            should_create_node = true;
        }
    }
    k_mutex_unlock(&node_mutex);

    if (should_create_node)
    {
        int ret = dect_mac_node_create_node(address, CONFIG_TX_POWER, capabilities.mcs_max);
        if (ret)
        {
            LOG_ERR("cqi: cannot create node");
        }

        result = capabilities.mcs_max + 1;
    }

    return result;
}

int dect_mac_node_create_node(uint32_t address, uint8_t tx_power, int8_t mcs)
{

    struct node *node_ptr;
    node_ptr = (struct node *)k_malloc(sizeof(struct node));
    // LOG_WRN("node_ptr: %p", (void*)node_ptr);

    node_ptr->address = address;
    node_ptr->tx_power = tx_power;
    node_ptr->mcs = mcs;
    node_ptr->used = false;

    int result;

    k_mutex_lock(&node_mutex, K_FOREVER);
    {
        int ret = sys_hashmap_insert(&node_hashmap, address, (uintptr_t)node_ptr, NULL);
        switch (ret)
        {
        case 0:
            LOG_WRN("node already exists, overwriting");
            result = OK;
            break;
        case 1:
            LOG_DBG("node created : %d", address);
            result = OK;
            break;
        case -ENOMEM:
            LOG_ERR("not enough memory to create node");
            k_free(node_ptr);
            result = NO_MEM_HEAP;
            break;
        case -ENOSPC:
            LOG_ERR("too many nodes already, cannot create node");
            k_free(node_ptr);
            result = NO_FREE_NODE;
            break;
        default:
            LOG_ERR("unexpected result from sys_hashmap_insert");
            k_free(node_ptr);
            result = UNKNOWN_ERR;
            break;
        }
    }
    k_mutex_unlock(&node_mutex);

    return result;
}

int dect_mac_node_delete_node(uint32_t address)
{

    struct node *node_ptr;
    int result;

    k_mutex_lock(&node_mutex, K_FOREVER);
    {
        bool ret = sys_hashmap_remove(&node_hashmap, address, (uint64_t *)&node_ptr);

        if (ret)
        {
            LOG_DBG("node %p deleted", (void *)node_ptr);
            k_free(node_ptr);
            result = OK;
        }
        else
        {
            LOG_ERR("node not found");
            result = NODE_NOT_FOUND;
        }
    }
    k_mutex_unlock(&node_mutex);

    return result;
}

int dect_mac_node_set_tx_power(uint32_t address, uint8_t tx_power)
{
    struct node *node_ptr;
    int result;

    k_mutex_lock(&node_mutex, K_FOREVER);
    {
        if (sys_hashmap_get(&node_hashmap, address, (uint64_t *)&node_ptr))
        {
            node_ptr->used = true; // mark node as used
            node_ptr->tx_power = tx_power;
            result = OK;
        }
        else
        {
            LOG_ERR("node not found");
            result = NODE_NOT_FOUND;
        }
    }
    k_mutex_unlock(&node_mutex);

    return result;
}

int dect_mac_node_set_mcs(uint32_t address, int8_t mcs)
{
    struct node *node_ptr;
    int result;

    k_mutex_lock(&node_mutex, K_FOREVER);
    {
        if (sys_hashmap_get(&node_hashmap, address, (uint64_t *)&node_ptr))
        {
            node_ptr->used = true; // mark node as used
            node_ptr->mcs = mcs;
            result = OK;
        }
        else
        {
            LOG_ERR("node not found");
            result = NODE_NOT_FOUND;
        }
    }
    k_mutex_unlock(&node_mutex);

    return result;
}

bool dect_mac_node_contains_node(uint32_t address)
{

    return sys_hashmap_contains_key(&node_hashmap, address);
}

int dect_mac_node_optimize(uint32_t address, int32_t rssi2, int32_t snr, uint8_t received_tx_power, int8_t received_mcs)
{

    int result = OK;

    k_mutex_lock(&node_mutex, K_FOREVER);
    {
        LOG_DBG("checking if node exists");
        if (!dect_mac_node_contains_node(address))
        {
            int ret = dect_mac_node_create_node(address, CONFIG_TX_POWER, capabilities.mcs_max);
            if (ret)
            {
                LOG_ERR("cannot create node");
                result = ret;
            }
        }

        LOG_INF("received_tx_power: %d, received_mcs: %d, rssi: %d, snr: %d", received_tx_power, received_mcs, rssi2, snr);

        /* -----------=| tx_power |=----------- */

        LOG_DBG("received_tx_power: %d, rssi: %d", received_tx_power, rssi2);

        int received_tx_power_dbm = 20;
        switch (received_tx_power)
        {
        case 0:
            received_tx_power_dbm = -40;
            break;
        case 1:
            received_tx_power_dbm = -30;
            break;
        case 2:
            received_tx_power_dbm = -20;
            break;
        case 3:
            received_tx_power_dbm = -16;
            break;
        case 4:
            received_tx_power_dbm = -12;
            break;
        case 5:
            received_tx_power_dbm = -8;
            break;
        case 6:
            received_tx_power_dbm = -4;
            break;
        case 7:
            received_tx_power_dbm = 0;
            break;
        case 8:
            received_tx_power_dbm = 4;
            break;
        case 9:
            received_tx_power_dbm = 7;
            break;
        case 10:
            received_tx_power_dbm = 10;
            break;
        case 11:
            received_tx_power_dbm = 13;
            break;
        case 12:
            received_tx_power_dbm = 16;
            break;
        case 13:
            received_tx_power_dbm = 19;
            break;
        case 14:
            received_tx_power_dbm = 21;
            break;
        case 15:
            received_tx_power_dbm = 23;
            break;
        default:
            LOG_WRN("received_tx_power not in range");
            result = POWER_NOT_IN_RANGE;
            break;
        }

        /* compute wanted power output */
        int8_t power_margin = CONFIG_TX_POWER_MARGIN_DBM; // offset to ensure good communication
        int wanted_tx_power_dbm = received_tx_power_dbm - (rssi2 - CONFIG_RSSI_TARGET - power_margin); // set tx power to rssi2
        LOG_DBG("wanted_tx_power_dbm: %d", wanted_tx_power_dbm);

        /* convert from dBm to transmit power (table 6.2.1-3 etsi dect-2020 mac layer) */
        int wanted_tx_power;
        if (wanted_tx_power_dbm <= -40)
        {
            // wanted_tx_power = 0;
            wanted_tx_power = 2; // after measuring, it seems that the power requiered to send the power "2" is lower than the power "0"
        }
        else if (wanted_tx_power_dbm <= -30)
        {
            // wanted_tx_power = 1;
            wanted_tx_power = 2; // after measuring, it seems that the power requiered to send the power "2" is lower than the power "1"
        }
        else if (wanted_tx_power_dbm <= -20)
        {
            wanted_tx_power = 2;
        }
        else if (wanted_tx_power_dbm <= -16)
        {
            wanted_tx_power = 3;
        }
        else if (wanted_tx_power_dbm <= -12)
        {
            wanted_tx_power = 4;
        }
        else if (wanted_tx_power_dbm <= -8)
        {
            wanted_tx_power = 5;
        }
        else if (wanted_tx_power_dbm <= -4)
        {
            wanted_tx_power = 6;
        }
        else if (wanted_tx_power_dbm <= 0)
        {
            wanted_tx_power = 7;
        }
        else if (wanted_tx_power_dbm <= 4)
        {
            wanted_tx_power = 8;
        }
        else if (wanted_tx_power_dbm <= 7)
        {
            wanted_tx_power = 9;
        }
        else if (wanted_tx_power_dbm <= 10)
        {
            wanted_tx_power = 10;
        }
        else if (wanted_tx_power_dbm <= 13)
        {
            wanted_tx_power = 11;
        }
        else if (wanted_tx_power_dbm <= 16)
        {
            wanted_tx_power = 12;
        }
        else if (wanted_tx_power_dbm <= 19)
        {
            wanted_tx_power = 13;
        }
        else if (wanted_tx_power_dbm <= 21)
        {
            wanted_tx_power = 13; // not enough power with this device to reach power 14
        }
        else
        {
            wanted_tx_power = 13; // not enough power with this device to reach power 15
        }

        LOG_DBG("wanted_tx_power: %d", wanted_tx_power);

        /* put wanted power into the node */
        dect_mac_node_set_tx_power(address, wanted_tx_power);
        LOG_DBG("tx_power set");

        /* -----------=| mcs |=----------- */

        LOG_DBG("received_mcs: %d, snr: %d", received_mcs, snr);

        /* compute wanted mcs */
        int8_t wanted_mcs;
        if (snr >= 14)
        {
            wanted_mcs = 4; // modulation 16QAM, Coding rate 3/4 -> 14dB min for <10% PER
        }
        else if (snr >= 10)
        {
            wanted_mcs = 3; // modulation 16QAM, Coding rate 1/2 -> 10dB min for <10% PER
        }
        else if (snr >= 8)
        {
            wanted_mcs = 2; // modulation QPSK, Coding rate 3/4 -> 8dB min for <10% PER
        }
        else if (snr >= 6)
        {
            wanted_mcs = 1; // modulation QPSK, Coding rate 1/2 -> 6dB min for <10% PER
        }
        else if (snr >= 4)
        {
            wanted_mcs = 0; // modulation BPSK, Coding rate 1/2 -> 4dB min for <10% PER
        }
        else
        {
            wanted_mcs = -1; // communication with <10% PER not possible
            LOG_WRN("channel is too noisy, cannot garantee communication with <10% PER");
            result = CHANNEL_TOO_NOISY;
        }

        LOG_DBG("wanted_mcs: %d", wanted_mcs);

        /* put wanted mcs into the node */
        dect_mac_node_set_mcs(address, wanted_mcs);
        LOG_DBG("mcs set");

        LOG_DBG("wanted_tx_power_dbm: %d, wanted_tx_power: %d, wanted_mcs: %d", wanted_tx_power_dbm, wanted_tx_power, wanted_mcs);
    }
    k_mutex_unlock(&node_mutex);

    return result;
}

int dect_mac_node_add_power(uint32_t address, int8_t power_to_add)
{
    uint64_t node_addr;
    struct node *node_ptr;
    int result;

    k_mutex_lock(&node_mutex, K_FOREVER);
    {
        if (sys_hashmap_get(&node_hashmap, address, (uint64_t *)&node_addr))
        {
            node_ptr = (struct node *)node_addr;
            node_ptr->used = true; // mark node as used
            node_ptr->tx_power += power_to_add;

            if (node_ptr->tx_power < 0)
            {
                LOG_DBG("cannot make power below 0, setting to 0");
                node_ptr->tx_power = 0;
            }
            else if (node_ptr->tx_power > CONFIG_TX_POWER)
            {
                LOG_DBG("cannot make power above %d, setting to %d", CONFIG_TX_POWER, CONFIG_TX_POWER);
                node_ptr->tx_power = CONFIG_TX_POWER;
            }
            else
            {
                LOG_DBG("new power: %d", node_ptr->tx_power);
            }

            result = OK;
        }
        else
        {
            LOG_ERR("node not found");
            result = NODE_NOT_FOUND;
        }
    }
    k_mutex_unlock(&node_mutex);

    return result;
}

int dect_mac_node_reduce_mcs(uint32_t address, int8_t mcs_to_reduce)
{
    uint64_t node_addr;
    struct node *node_ptr;
    int result;

    k_mutex_lock(&node_mutex, K_FOREVER);
    {
        if (sys_hashmap_get(&node_hashmap, address, (uint64_t *)&node_addr))
        {
            node_ptr = (struct node *)node_addr;
            node_ptr->used = true; // mark node as used
            node_ptr->mcs -= mcs_to_reduce;

            if (node_ptr->mcs < 0)
            {
                LOG_DBG("cannot reduce mcs below 0, setting to 0");
                node_ptr->mcs = 0;
                result = MIN_MCS_REACHED;
            }
            else if (node_ptr->mcs > capabilities.mcs_max)
            {
                LOG_DBG("cannot makes the mcs above %d, setting to %d", capabilities.mcs_max, capabilities.mcs_max);
                node_ptr->mcs = capabilities.mcs_max;
                result = MAX_MCS_REACHED;
            }
            else
            {
                LOG_DBG("new mcs: %d", node_ptr->mcs);
                result = OK;
            }
        }
        else
        {
            LOG_ERR("node not found");
            result = NODE_NOT_FOUND;
        }
    }
    k_mutex_unlock(&node_mutex);

    return result;
}

int dect_mac_node_full_power(uint32_t address)
{
    uint64_t node_addr;
    struct node *node_ptr;
    int result;

    k_mutex_lock(&node_mutex, K_FOREVER);
    {
        if (sys_hashmap_get(&node_hashmap, address, (uint64_t *)&node_addr))
        {
            node_ptr = (struct node *)node_addr;
            node_ptr->used = true; // mark node as used

            node_ptr->tx_power = CONFIG_TX_POWER;

            result = OK;
        }
        else
        {
            LOG_ERR("node not found");
            result = NODE_NOT_FOUND;
        }
    }
    k_mutex_unlock(&node_mutex);

    return result;
}
```

## src/dect_mac_node.h
```c
#ifndef DECT_MAC_NODE
#define DECT_MAC_NODE

#include <zephyr/kernel.h>
#include <zephyr/sys/hash_map.h>

#include "dect_mac_phy_handler.h"
#include "dect_mac_error_code.h"

/* define the minimum time that a node will kept if not used
(the node will be deleted after two cycle so it can
take up to double the time with a average at 1.5 times the time) */
#define DECT_MAC_NODE_DELETE_TIMEOUT K_MINUTES(10)

/* struct that represent a node */
struct node
{
    uint32_t address;
    bool used;
    uint8_t tx_power;
    int8_t mcs;
    uint32_t buffer_size;
};

/* hashmap that contains all the nodes, the keys are the nodes addresses */
extern struct sys_hashmap node_hashmap;

/* mutex to protect the node_hashmap */
extern struct k_mutex node_mutex;

/* thread that handle the deletion of the not used nodes */
void dect_mac_node_thread();

/* function that cleans all the nodes not used in the past #DECT_MAC_NODE_DELETE_TIMEOUT */
void dect_mac_node_clean_unused_nodes();

/* function that get the tx power of a node */
uint8_t dect_mac_node_get_tx_power(uint32_t address);

/* function that get the mcs of a node */
int8_t dect_mac_node_get_mcs(uint32_t address);

/* function that get the cqi of a node */
uint8_t dect_mac_node_get_cqi(uint32_t address);

/* function that create a node and put it in the hashmap */
int dect_mac_node_create_node(uint32_t address, uint8_t tx_power, int8_t mcs);

/* function that delete a node from the hashmap */
int dect_mac_node_delete_node(uint32_t address);

/* function that check if a node is in the hashmap */
bool dect_mac_node_contains_node(uint32_t address);

/* function that set the tx power of a node */
int dect_mac_node_set_tx_power(uint32_t address, uint8_t tx_power);

/* function that set the mcs of a node */
int dect_mac_node_set_mcs(uint32_t address, int8_t mcs);

/* function that optimize the transmission power and modulation to the lowest while still ensuring communication. */
int dect_mac_node_optimize(uint32_t address, int32_t rssi2, int32_t snr, uint8_t received_tx_power, int8_t received_mcs);

/* function that add power to a node */
int dect_mac_node_add_power(uint32_t address, int8_t power_to_add);

/* function that reduce the mcs level of a node */
int dect_mac_node_reduce_mcs(uint32_t address, int8_t mcs_to_reduce);

/* function that maxes the power of a node */
int dect_mac_node_full_power(uint32_t address);

#endif // DECT_MAC_NODE
```

## src/dect_mac_phy_handler.h
```c
#ifndef DECT_MAC_PHY_HANDLER_H
#define DECT_MAC_PHY_HANDLER_H

#include <zephyr/kernel.h>
#include <nrf_modem_dect_phy.h>
#include <zephyr/drivers/hwinfo.h>

#include "dect_mac_phy_handler_types.h"
#include "dect_mac_phy_handler_cb.h"

#define DECT_MAC_START_TIME_NOW_DELAY NRF_MODEM_DECT_MODEM_TIME_TICK_RATE_KHZ*2

/* functions to start and stop the modem, the modem should be started when using the other commands */
int dect_mac_phy_handler_start_modem();
int dect_mac_phy_handler_stop_modem();

/* functions that simplify the access to the phy layer api */
void dect_mac_phy_handler_capability_get();
void dect_mac_phy_handler_init();
void dect_mac_phy_handler_deinit();
void dect_mac_phy_handler_rx(struct dect_mac_phy_handler_rx_params params);
void dect_mac_phy_handler_tx(struct dect_mac_phy_handler_tx_params params);
void dect_mac_phy_handler_tx_harq(struct dect_mac_phy_handler_tx_harq_params params);
void dect_mac_phy_handler_tx_rx(struct dect_mac_phy_handler_tx_rx_params params);
void dect_mac_phy_handler_rssi(struct dect_mac_phy_handler_rssi_params params);
void dect_mac_phy_handler_cancel(struct dect_mac_phy_handler_cancel_params params);
void dect_mac_phy_handler_radio_config(struct dect_mac_phy_handler_radio_config_params params);
void dect_mac_phy_handler_link_config();
void dect_mac_phy_handler_time_get();

#define DECT_MAC_PHY_HANDLER_TRUE_TX_PARAM_CREATE(name, phy_handler_param) \
    struct nrf_modem_dect_phy_tx_params name;                              \
    union nrf_modem_dect_phy_hdr header;                                   \
    name.phy_header = &header;                                             \
    dect_mac_phy_handler_tx_config(&phy_handler_param, &name);

void dect_mac_phy_handler_tx_config(struct dect_mac_phy_handler_tx_params *input_params, struct nrf_modem_dect_phy_tx_params *output_params);

#define DECT_MAC_PHY_HANDLER_TRUE_RX_PARAM_CREATE(name, phy_handler_param) \
    struct nrf_modem_dect_phy_rx_params name;                              \
    dect_mac_phy_handler_rx_config(&phy_handler_param, &name);

void dect_mac_phy_handler_rx_config(struct dect_mac_phy_handler_rx_params *input_params, struct nrf_modem_dect_phy_rx_params *output_params);

/* variable that holds the capability of the modem (declared in dect_mac_phy_handler_cb.c) */
extern struct dect_capabilities capabilities;

/* variable that holds the device id of the device (declared in dect_mac_phy_handler.c) */
extern uint16_t device_id;

/* variable that represent the current state of the modem (declared in dect_mac_phy_handler.c) */
extern enum dect_mac_phy_state current_state;

/* variable that represent the current radio mode of the modem (declared in dect_mac_phy_handler.c) */
extern enum nrf_modem_dect_phy_radio_mode current_radio_mode;


extern uint32_t test_mcs;
extern uint32_t test_power;
extern uint32_t test_packet_length;

#endif // DECT_MAC_PHY_HANDLER_H
```
